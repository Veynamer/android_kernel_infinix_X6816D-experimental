## drivers/input/touchscreen/adaptive_ts_transsion/Kconfig
```kconfig
#
# Novatek NT36xxx adaptive touchscreen driver configuration
#
config CONFIG_TOUCHSCREEN_ADAPTIVE_NT36XXX
	tristate "Novatek NT36xxx adaptive driver"
	help
	  Say Y here if you have a Novatek NT36xxx touchscreen.

	  If unsure, say N.
config CONFIG_TOUCHSCREEN_ADAPTIVE_NT36XXX_SPI
    tristate "Novatek NT36xxx adaptive spi driver"
	help
	  Say Y here if you have a Novatek NT36xxx touchscreen connected
	  to your system by SPI.
```

## drivers/misc/hwinfo/Kconfig
```kconfig
menuconfig HWINFO_SUPPORT
	bool "Enable hwinfo extensions"
	help
	  All sagereal basic APIs is put to drivers/misc/hwinfo directory.
	  There are hwinfo, gesture, debug, misc and so on.
	  Say N only if you want to build MTK origin version.

if HWINFO_SUPPORT
config CUSTOM_HWINFO
	bool "Enable Custom hwinfo interface"
	help
	  If enabled, /sys/sr/hwinfo directory hold many
	  hardware module information, such as TP vendor.
	  It is required by MIDtest APK.

config CUSTOM_MISC
	bool "Enable Custom hardware control misc interface"
	help
	  Some device export interface (other than gesture hwinfo debug or so) for system level control,
	  We put them under /sys/sr/misc

config CUSTOM_PERFGOV_ENHANCEMENT
	bool "performance governor enhancement"
	help
	  If enabled, support performance governor enhancement

config CUSTOM_CHARGE_SUPPORT
	bool "Custom charge driver support"
	default y
	help
	  Custom charge driver support.

config TOUCHPANEL_CHARGE_NOISE
    config TOUCHPANEL_CHARGE_NOISE
	bool "Enable touchpanel charge noise interface"
	help
	  If enabled, set notifier from kernel to module
endif # HWINFO_SUPPORT
```
